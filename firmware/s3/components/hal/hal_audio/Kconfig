## firmware/s3/components/hal/hal_audio/Kconfig
```kconfig
menu "Watcher HAL Audio"

    config WATCHER_AUDIO_RECORD_SAMPLE_RATE
        int "Microphone sample rate (Hz)"
        default 16000
        help
            Sample rate for audio recording. ASR expects 16000 Hz.

    config WATCHER_AUDIO_PLAY_SAMPLE_RATE
        int "Speaker sample rate for TTS (Hz)"
        default 24000
        help
            Default sample rate for TTS playback. Can be changed at runtime
            via hal_audio_set_sample_rate().

    config WATCHER_AUDIO_VOLUME
        int "Default speaker volume (0-100)"
        default 80
        range 0 100
        help
            Initial speaker volume. Values above 80 may cause clipping.

endmenu
```

## firmware/s3/components/hal/hal_button/Kconfig
```kconfig
menu "Watcher HAL Button"

    config WATCHER_BUTTON_GPIO
        int "Button GPIO number"
        default 41
        help
            GPIO pin for the encoder button. Default 41 (encoder push-button).

    config WATCHER_BUTTON_DEBOUNCE_MS
        int "Button debounce time (ms)"
        default 20
        range 5 100
        help
            Debounce period in milliseconds to filter mechanical switch bounce.

endmenu
```

## firmware/s3/components/hal/hal_camera/Kconfig
```kconfig
menu "Watcher HAL Camera"

    config WATCHER_CAMERA_CONNECT_TIMEOUT_MS
        int "Camera coprocessor connect timeout (ms)"
        default 5000
        range 1000 30000
        help
            Maximum time to wait for the HX6538 INIT@STAT connect event
            after SSCMA client initialization.

    config WATCHER_CAMERA_CAPTURE_TIMEOUT_MS
        int "One-shot camera capture timeout (ms)"
        default 5000
        range 1000 30000
        help
            Maximum time to wait for a one-shot camera INVOKE result
            containing an image payload.

endmenu
```

## firmware/s3/components/hal/hal_display/Kconfig
```kconfig
menu "Watcher HAL Display"

    config WATCHER_DISPLAY_BRIGHTNESS
        int "LCD backlight brightness (0-100)"
        default 50
        range 0 100
        help
            Initial LCD backlight brightness percentage.

    config WATCHER_DISPLAY_TEXT_MAX_CHARS
        int "Maximum characters before text truncation"
        default 30
        range 10 100
        help
            Text longer than this value will be truncated with "..." suffix.

endmenu
```

## firmware/s3/components/hal/hal_servo/Kconfig
```kconfig
menu "Watcher HAL Servo"

    config WATCHER_SERVO_X_GPIO
        int "Servo X axis GPIO number"
        default 19
        help
            GPIO pin for X-axis servo PWM output.
            Default 19 (previously UART TX to MCU, repurposed in v2.0).

    config WATCHER_SERVO_Y_GPIO
        int "Servo Y axis GPIO number"
        default 20
        help
            GPIO pin for Y-axis servo PWM output.
            Default 20 (previously UART RX from MCU, repurposed in v2.0).

    config WATCHER_SERVO_Y_MIN_DEG
        int "Servo Y axis minimum angle (degrees)"
        default 90
        range 0 180
        help
            Mechanical protection lower limit for Y axis (prevents hardware damage).

    config WATCHER_SERVO_Y_MAX_DEG
        int "Servo Y axis maximum angle (degrees)"
        default 150
        range 0 180
        help
            Mechanical protection upper limit for Y axis.

    config WATCHER_SERVO_SMOOTH_STEP_MS
        int "Smooth move step interval (ms)"
        default 10
        range 5 50
        help
            Time between interpolation steps during smooth servo movement.

endmenu
```

## firmware/s3/components/protocols/ble_service/Kconfig
```kconfig
menu "Watcher BLE Service"

    config WATCHER_BLE_ENABLE
        bool "Enable BLE motion control service"
        default n
        help
            Enables BLE GATT server for servo motion control commands.
            Wi-Fi provisioning is intentionally not included in this iteration.

    config WATCHER_BLE_DEVICE_NAME
        string "BLE device name"
        depends on WATCHER_BLE_ENABLE
        default "WATCHER_S3"
        help
            BLE advertising name shown to mobile clients.

    config WATCHER_BLE_CMD_DEFAULT_DURATION_MS
        int "Default servo move duration (ms)"
        depends on WATCHER_BLE_ENABLE
        range 0 5000
        default 300
        help
            Default movement duration for BLE commands without explicit duration.
            0 means immediate move.

endmenu
```

## firmware/s3/components/services/anim_service/Kconfig
```kconfig
menu "Watcher Animation Service"

    config WATCHER_ANIM_FPS
        int "Animation frame rate (FPS)"
        default 10
        range 1 60
        help
            Target frame rate for emoji animations.
            Higher values provide smoother animation but require faster frame decoding.
            Default 10fps balances smoothness with lower decode and memory pressure.

    config WATCHER_ANIM_MAX_FRAMES_PER_TYPE
        int "Maximum frames per animation type"
        default 24
        range 1 48
        help
            Maximum number of frames per animation type.
            Each frame uses approximately 83KB of PSRAM at 206x206 RGB565.

    config WATCHER_ANIM_WARM_BUDGET_KB
        int "Warm cache budget (KB)"
        default 1024
        range 128 4096
        help
            Budget for always-on first-frame cache. 1024KB fits 10 states
            at 206x206 RGB565 with some metadata headroom.

    config WATCHER_ANIM_HOT_BUDGET_KB
        int "Hot cache budget (KB)"
        default 4096
        range 1024 8192
        help
            Budget for active and inactive hot caches used for double-buffered
            animation switching. 4096KB covers two 24-frame 206x206 animations.

    config WATCHER_ANIM_SAFETY_MARGIN_KB
        int "Animation safety margin (KB)"
        default 512
        range 128 2048
        help
            Reserved PSRAM that animation code should not consume, leaving room
            for LVGL, voice, and networking workloads.

    config WATCHER_ANIM_SWITCH_FADE_MS
        int "Switch fade duration (ms)"
        default 140
        range 0 1000
        help
            Duration for the lightweight crossfade between animation states.

    config WATCHER_ANIM_LAZY_LOAD
        bool "Enable lazy loading of animation frames"
        default y
        help
            Only load animation frames into PSRAM when needed.
            Reduces memory usage by keeping only one animation type cached at a time.
            Type switch latency is typically <500ms.

    config WATCHER_ANIM_CACHE_RGB565
        bool "Enable RGB565 cache for fast frame switching"
        default y
        help
            Decode PNG images to RGB565-compatible LVGL image buffers and cache
            them in PSRAM. Enables smooth playback and asynchronous switching.

    config WATCHER_ANIM_DEBUG_PERF
        bool "Enable animation performance logging"
        default n
        help
            Log actual FPS and frame switching latency every 30 frames.
            Useful for debugging animation performance issues.

endmenu
```

## firmware/s3/components/services/camera_service/Kconfig
```kconfig
menu "Watcher Camera Service"

    config WATCHER_CAMERA_BOOT_DIAG
        bool "Enable boot-time camera diagnostic capture"
        default n
        help
            Run a non-fatal one-shot camera capture after boot completes.
            Useful for validating the HX6538 communication path on hardware.

endmenu
```

## firmware/s3/main/Kconfig.projbuild
```kconfig
menu "Watcher Logging"

    config WATCHER_LOG_HEAP_DIAGNOSTICS
        bool "Enable heap diagnostic logs"
        default n
        help
            Compile in detailed internal/PSRAM heap snapshot logs used while
            investigating startup and low-memory recovery behavior.

    config WATCHER_CAMERA_VERBOSE_LOGS
        bool "Enable verbose camera diagnostics logs"
        default n
        help
            Compile in HX6538 info/model/catalog diagnostic logging. Disabling
            this removes large format strings and skips extra diagnostic queries.

    config WATCHER_WIFI_REASON_NAME_LOGS
        bool "Enable WiFi disconnect reason name strings"
        default n
        help
            Include human-readable WiFi disconnect reason names in warning logs.
            Disable this to keep only numeric reason codes and save flash/rodata.

endmenu
```

## firmware/s3/sdkconfig.defaults
```kconfig
# ESP32-S3 configuration
CONFIG_IDF_TARGET="esp32s3"

# Flash
CONFIG_BOOTLOADER_CACHE_32BIT_ADDR_QUAD_FLASH=y
CONFIG_ESPTOOLPY_FLASH_MODE_AUTO_DETECT=n
CONFIG_ESPTOOLPY_FLASHMODE_QIO=y
CONFIG_ESPTOOLPY_FLASHSIZE_16MB=y
CONFIG_ESPTOOLPY_FLASHSIZE="16MB"

# ESP32-S3 Cache Configuration (CRITICAL for PSRAM performance)
CONFIG_ESP32S3_INSTRUCTION_CACHE_16KB=y
CONFIG_ESP32S3_INSTRUCTION_CACHE_8WAYS=y
CONFIG_ESP32S3_INSTRUCTION_CACHE_LINE_32B=y
CONFIG_ESP32S3_DATA_CACHE_32KB=y
CONFIG_ESP32S3_DATA_CACHE_8WAYS=y
CONFIG_ESP32S3_DATA_CACHE_LINE_32B=y

# PSRAM (required for audio buffers and LVGL)
CONFIG_SPIRAM=y
CONFIG_SPIRAM_MODE_OCT=y
CONFIG_SPIRAM_SPEED_80M=y
CONFIG_SPIRAM_MALLOC_ALWAYSINTERNAL=1024
CONFIG_SPIRAM_MALLOC_RESERVE_INTERNAL=262144
CONFIG_SPIRAM_ALLOW_BSS_SEG_EXTERNAL_MEMORY=y
CONFIG_SPIRAM_ALLOW_STACK_EXTERNAL_MEMORY=y
CONFIG_SPIRAM_TRY_ALLOCATE_WIFI_LWIP=y
CONFIG_SPIRAM_BOOT_INIT=y
CONFIG_SPIRAM_USE_MALLOC=y
CONFIG_SPIRAM_MEMTEST=y

# CPU
CONFIG_ESP_DEFAULT_CPU_FREQ_MHZ_240=y

# SPI Master (in IRAM for performance)
CONFIG_SPI_MASTER_IN_IRAM=y
CONFIG_SPI_MASTER_ISR_IN_IRAM=y

# WiFi
CONFIG_ESP_WIFI_ENABLED=y
CONFIG_ESP_WIFI_STATIC_RX_BUFFER_NUM=10
CONFIG_ESP_WIFI_RX_BA_WIN=6

# WebSocket
CONFIG_ESP_WEBSOCKET_CLIENT_ENABLED=y

# I2S (audio)
CONFIG_ESP_I2S_ENABLED=y

# FreeRTOS
CONFIG_FREERTOS_HZ=1000
CONFIG_FREERTOS_TIMER_TASK_STACK_DEPTH=1600

# Task stack sizes
CONFIG_ESP_MAIN_TASK_STACK_SIZE=16384
CONFIG_ESP_TIMER_TASK_STACK_SIZE=2600
CONFIG_ESP_INT_WDT_TIMEOUT_MS=10000

# Log level
CONFIG_LOG_DEFAULT_LEVEL_INFO=y

# Watchdog
CONFIG_ESP_TASK_WDT_INIT=y
CONFIG_ESP_TASK_WDT_TIMEOUT_S=30

# Console
CONFIG_ESP_CONSOLE_SECONDARY_NONE=y

# LWIP
CONFIG_LWIP_LOCAL_HOSTNAME="MVP-W"

# LCD Panel
CONFIG_LCD_PANEL_IO_FORMAT_BUF_SIZE=32
CONFIG_BSP_LCD_DEFAULT_BRIGHTNESS=0
CONFIG_BSP_LCD_PANEL_SPI_TRANS_Q_DEPTH=1
CONFIG_BSP_LCD_SPI_DMA_SIZE_DIV=16

# LVGL Core
CONFIG_LV_CONF_SKIP=y
CONFIG_LV_COLOR_DEPTH_16=y
CONFIG_LV_COLOR_DEPTH=16
CONFIG_LV_COLOR_16_SWAP=y
CONFIG_LV_COLOR_MIX_ROUND_OFS=128
CONFIG_LV_DPI_DEF=130

# LVGL Memory (use PSRAM for large buffers like PNG animations)
CONFIG_LV_MEM_CUSTOM=y
CONFIG_LV_MEM_SIZE_KILOBYTES=1536

# LVGL File System
CONFIG_LV_USE_FS_STDIO=y
CONFIG_LV_FS_STDIO_LETTER=83
CONFIG_LV_FS_STDIO_CACHE_SIZE=0
CONFIG_LV_USE_FS_POSIX=y
CONFIG_LV_FS_POSIX_LETTER=83
CONFIG_LV_FS_POSIX_PATH=""
CONFIG_LV_FS_POSIX_CACHE_SIZE=0

# LVGL PNG decoder
CONFIG_LV_USE_PNG=y
CONFIG_LV_IMG_CACHE_DEF_SIZE=1

# LVGL Text
CONFIG_LV_TXT_ENC_UTF8=y
CONFIG_LV_USE_USER_DATA=y

# LVGL Assert
CONFIG_LV_USE_ASSERT_NULL=y
CONFIG_LV_USE_ASSERT_MALLOC=y

# LVGL Theme
CONFIG_LV_USE_THEME_DEFAULT=y
CONFIG_LV_THEME_DEFAULT_GROW=y
CONFIG_LV_THEME_DEFAULT_TRANSITION_TIME=80
CONFIG_LV_USE_THEME_BASIC=y

# LVGL Layout
CONFIG_LV_USE_FLEX=y
CONFIG_LV_USE_GRID=y

# LVGL Port (esp_lvgl_port component)
CONFIG_LVGL_DRAW_BUFF_HEIGHT=412
CONFIG_LVGL_PORT_TASK_STACK_SIZE=10240
CONFIG_LVGL_PORT_TASK_PRIORITY=11
CONFIG_LVGL_PORT_TASK_AFFINITY_CPU1=y
CONFIG_LVGL_PORT_TASK_STACK_ALLOC_EXTERNAL=y
CONFIG_LVGL_PORT_TASK_MAX_SLEEP_MS=5
CONFIG_LVGL_PORT_TIMER_PERIOD_MS=5

# SPI Master
CONFIG_SPI_MASTER=y

# Partition Table (use custom partitions.csv)
CONFIG_PARTITION_TABLE_CUSTOM=y
CONFIG_PARTITION_TABLE_CUSTOM_FILENAME="partitions.csv"

# SPIFFS
CONFIG_SPIFFS_MAX_PARTITIONS=3
CONFIG_SPIFFS_CACHE=y
CONFIG_SPIFFS_CACHE_WR=y
CONFIG_SPIFFS_PAGE_CHECK=y
CONFIG_SPIFFS_GC_MAX_RUNS=10
CONFIG_SPIFFS_PAGE_SIZE=256
CONFIG_SPIFFS_OBJ_NAME_LEN=32
CONFIG_SPIFFS_USE_MAGIC=y
CONFIG_SPIFFS_USE_MAGIC_LENGTH=y
CONFIG_SPIFFS_META_LENGTH=4
CONFIG_SPIFFS_USE_MTIME=y

# LVGL CJK font support for Chinese characters
CONFIG_LV_FONT_SIMSUN_16_CJK=y

# ESP-SR Wake Word Model (你好小智)
CONFIG_SR_WN_WN9_NIHAOXIAOZHI_TTS=y

# LCD debug
CONFIG_LCD_ENABLE_DEBUG_LOG=n
```
